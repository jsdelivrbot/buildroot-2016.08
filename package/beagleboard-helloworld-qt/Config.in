## package/beagleboard-helloworld-qt/Config.in
```kconfig
config BR2_PACKAGE_BEAGLEBOARD_HELLOWORLD_QT
	bool "Beagleboard Hello world example on Qt"
	select BR2_PACKAGE_QT
	select BR2_PACKAGE_QT_GUI_MODULE
	help
          Example application.
```

## package/wqy-microhei/Config.in
```kconfig
config BR2_PACKAGE_WQY_MICROHEI
	bool "Wenquanyi Microhei"
	help
	  The DejaVu fonts are a font family based on the Vera Fonts.
	  Its purpose is to provide a wider range of characters while
	  maintaining the original look and feel through the process
	  of collaborative development, under a Free license.

	  http://dejavu-fonts.org

	  WenQuanYi Micro Hei is a Hei-Ti style (sans-serif type) Chinese font.
	  It was designed for general purpose text formatting and on-screen
	  display of Chinese characters among many other languages. The embolden
	  strokes of the font glyphs produces enhanced screen contrast, making
	  it easier to read and recognize. The embedded bitmap glyphs further
	  enhance on-screen performance, and can be enabled with the provided
	  configuration files.
```
